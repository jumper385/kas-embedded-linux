## meta-oddesey/conf/layer.conf
```bitbake
BBPATH .= ":${LAYERDIR}"

BBFILES += "${LAYERDIR}/recipes-*/*/*.bb \
            ${LAYERDIR}/recipes-*/*/*.bbappend"

BBFILE_COLLECTIONS += "oddesey"
BBFILE_PATTERN_oddesey = "^${LAYERDIR}/"
BBFILE_PRIORITY_oddesey = "7"
BBFILE_PATTERN_IGNORE_EMPTY_oddesey = "1"

LAYERDEPENDS_oddesey = "core openembedded-layer meta-python stm-st-stm32mp stm-st-stm32mp-mx"
LAYERSERIES_COMPAT_oddesey = "scarthgap"

# ST EULA file for this machine (see section 7)
EULA_FILE_ST:stm32mp13-oddesey = "${LAYERDIR}/conf/eula/${MACHINE}"
EULA_FILE_ST_MD5SUM:stm32mp13-oddesey = "8b505090fb679839cefbcc784afe8ce9"
```
